   !
   ! 32 Bit Programs, include these Prototypes
   !
COMPILE('***', _WIDTH32_)
      MODULE('CLACom API')
         CapPutc(SHORT,BYTE),DLL,PASCAL,NAME('_Func003@8')
         CapPuts(SHORT,*CSTRING),RAW,DLL,PASCAL,NAME('_Func004@8')
         CenterNonMDIWindow(LONG ParentWin,LONG MyWin),DLL,PASCAL,NAME('_Func001@8')
         CheckIfSmallFonts(),SHORT,DLL,PASCAL,NAME('_Func006@0')
         CheckIfTermActive(SHORT),SHORT,DLL,PASCAL,NAME('_Func007@4')
         CLAFindWindow(*CSTRING WinClass,*CSTRING WinTitle),SHORT,RAW,DLL,PROC,PASCAL,NAME('_Func008@8')
         CLATermClearScreen(SHORT port),DLL,PASCAL,NAME('_Func096@4')
         CLATermClientProc(SHORT port,LONG hWnd,LONG msg,LONG wParam,LONG lParam),LONG,DLL,PROC,PASCAL,NAME('_Func092@20')
         CLATermDoorWay(SHORT port,SHORT flag),DLL,PASCAL,NAME('_Func095@8')
         CLATermEcho(SHORT port,SHORT flag),DLL,PASCAL,NAME('_Func094@8')
         CLATermGainFocus(SHORT port),DLL,PASCAL,NAME('_Func099@4')
         CLATermGetMessage(LONG msgaddr,*GROUP clamsg),DLL,RAW,PASCAL,NAME('_Func093@8')
         CLATermPrepareTransfer(SHORT port,SHORT how),DLL,PASCAL,NAME('_Func097@8')
         CLATermSetBackColor(SHORT port,SHORT how),PASCAL,DLL,NAME('_Func098@8')
         CLATermSetNotify(SHORT port,SHORT how),SHORT,PROC,DLL,PASCAL,NAME('_Func119@8')
         CLATermWndProc(SHORT port,LONG hWnd,LONG msg,LONG wParam,LONG lParam),LONG,DLL,PASCAL,NAME('_Func091@20')
         ClearVariable(*CSTRING,LONG,LONG),RAW,DLL,PASCAL,NAME('_Func110@12')
         ClrBuf(SHORT),DLL,PASCAL,NAME('_Func017@4')
         ClrRecvBuf(SHORT),DLL,PASCAL,NAME('_Func023@4')
         ClrTransBuf(SHORT),DLL,PASCAL,NAME('_Func011@4')
         ComDelay(LONG hWnd,SHORT tics),SHORT,DLL,PASCAL,PROC,NAME('_Func012@8')
         ComGetb(SHORT,*CSTRING),SHORT,RAW,DLL,PASCAL,NAME('_Func013@8')
         ComGetbFilter(SHORT,*CSTRING),SHORT,RAW,DLL,PASCAL,NAME('_Func014@8')
         ComGetBlock(SHORT,*CSTRING,SHORT),SHORT,RAW,DLL,PASCAL,NAME('_Func015@12')
         ComGetBlockCRC(SHORT,*CSTRING,SHORT),SHORT,RAW,DLL,PASCAL,NAME('_Func016@12')
         ComGetc(SHORT),SHORT,DLL,PASCAL,NAME('_Func009@4')
         ComGetd(SHORT port,LONG hWnd,SHORT secs),SHORT,DLL,PASCAL,NAME('_Func018@12')
         ComGets(SHORT,*CSTRING,BYTE),SHORT,RAW,DLL,PASCAL,NAME('_Func111@12')
         ComPutb(SHORT,*CSTRING,SHORT),SHORT,PROC,RAW,DLL,PASCAL,NAME('_Func010@12')
         ComPutbCRC(SHORT,*CSTRING,SHORT),SHORT,PROC,RAW,DLL,PASCAL,NAME('_Func050@12')
         ComPutc(SHORT,BYTE),SHORT,PROC,DLL,PASCAL,NAME('_Func025@8')
         ComPuts(SHORT,*CSTRING),SHORT,PROC,RAW,DLL,PASCAL,NAME('_Func072@8')
         ComPutsCtrl(SHORT,*CSTRING),SHORT,PROC,RAW,DLL,PASCAL,NAME('_Func112@8')
         CreateClaTerm(SHORT,LONG,SHORT,SHORT),SHORT,DLL,PASCAL,NAME('_Func028@16')
         CreateClaTermEX(SHORT,LONG,SHORT,SHORT,LONG,SHORT,SHORT,SHORT),SHORT,DLL,PASCAL,NAME('_Func029@32')
         CreateCLATermNoWin(SHORT,LONG,SHORT,SHORT,LONG,LONG),SHORT,DLL,PASCAL,NAME('_Func089@24')
         DebugFileOpen(SHORT port),DLL,PASCAL,NAME('_Func030@4')
         DelPathFiles(*CSTRING path),RAW,DLL,PASCAL,NAME('_Func031@4')
         DisplayErrors(SHORT port,LONG hWnd),DLL,PASCAL,NAME('_Func032@8')
         DisplayPortError(SHORT error),DLL,PASCAL,NAME('_Func034@4')
         DisplayTermError(SHORT error),DLL,PASCAL,NAME('_Func035@4')
         DownLoad(SHORT,LONG,SHORT),SHORT,DLL,PROC,PASCAL,NAME('_Func047@12')
         DownLoadEx(SHORT,LONG,SHORT,*CSTRING,*CSTRING),SHORT,RAW,DLL,PROC,PASCAL,NAME('_Func066@20')
         Dtr(SHORT port,SHORT how),DLL,PASCAL,NAME('_Func038@8')
         GetCommParams(SHORT,*GROUP),SHORT,RAW,DLL,PROC,PASCAL,NAME('_Func039@8')
         GetConnectSpeed(*CSTRING),LONG,RAW,DLL,PASCAL,NAME('_Func040@4')
         GetCRC16(*CSTRING,SHORT),USHORT,RAW,DLL,PASCAL,NAME('_Func041@8')
         GetCRC32(*CSTRING,SHORT),LONG,RAW,DLL,PASCAL,NAME('_Func042@8')
         GetDirectory1(LONG parentWin,*CSTRING title,*CSTRING dir),SHORT,RAW,DLL,PASCAL,NAME('_Func043@12')
         GetEnvironmentVar(*CSTRING EnvVar),SHORT,RAW,PASCAL,DLL,PROC,NAME('_Func021@4')
         GetOpenSaveFile1(LONG,*CSTRING,*CSTRING,*CSTRING,*CSTRING,SHORT,SHORT),SHORT,RAW,DLL,PASCAL,NAME('_Func046@28')
         GetParentWindow(LONG hWnd),LONG,DLL,PASCAL,NAME('_Func044@4')
         GetProtoNum(*CSTRING),SHORT,RAW,DLL,PASCAL,NAME('_Func045@4')
         GetTermEnter(SHORT,*CSTRING,*CSTRING),RAW,DLL,PASCAL,NAME('_Func036@12')
         GetWindowsPort(SHORT),SIGNED,DLL,PASCAL,NAME('_Func048@4')
         GetZmodem(SHORT port,LONG hWnd),SHORT,DLL,PROC,PASCAL,NAME('_Func114@8')
         GetZmodemEx(SHORT port,LONG hWnd,*CSTRING lpath),SHORT,RAW,DLL,PROC,PASCAL,NAME('_Func024@12')
         InitPort(SHORT,LONG,SHORT,SHORT,SHORT),SHORT,DLL,PROC,PASCAL,NAME('_Func115@20')
         Iscd(SHORT),SHORT,DLL,PASCAL,NAME('_Func052@4')
         IsRing(SHORT),SHORT,DLL,PASCAL,NAME('_Func053@4')
         MakeDir(*CSTRING),SHORT,RAW,DLL,PROC,PASCAL,NAME('_Func054@4')
         ModemHangUp(SHORT),DLL,PASCAL,NAME('_Func055@4')
         ModemPuts(SHORT,*CSTRING),SHORT,PROC,RAW,DLL,PASCAL,NAME('_Func056@8')
         ModemStat(SHORT),BYTE,DLL,PASCAL,NAME('_Func057@4')
         RecvCount(SHORT),SHORT,DLL,PASCAL,NAME('_Func058@4')
         ResetPort(SHORT port,LONG hWnd),SHORT,DLL,PROC,PASCAL,NAME('_Func059@8')
         ResetPortHaveID(SHORT port,LONG hWnd),DLL,PASCAL,NAME('_Func060@8')
         Rts(SHORT,SHORT),DLL,PASCAL,NAME('_Func061@8')
         Rxempty(SHORT),SHORT,DLL,PASCAL,NAME('_Func062@4')
         SendBreak(SHORT),DLL,PASCAL,NAME('_Func063@4')
         SendFileWild(SHORT,LONG,*CSTRING,*CSTRING,SHORT),SHORT,RAW,DLL,PROC,PASCAL,NAME('_Func064@20')
         SendZmodem(SHORT port,LONG hWnd),SHORT,DLL,PROC,PASCAL,NAME('_Func065@8')
         SendZmodemEx(SHORT,LONG,*CSTRING,*CSTRING,SHORT),SHORT,RAW,DLL,PROC,PASCAL,NAME('_Func037@20')
         SetCaptureBuf(SHORT,SHORT),SHORT,DLL,PROC,PASCAL,NAME('_Func067@8')
         SetCaptureFile(SHORT,*CSTRING),RAW,DLL,PASCAL,NAME('_Func068@8')
         SetCommTimeOut(SHORT,SHORT),DLL,PASCAL,NAME('_Func118@8')
         SetFileXferCallBack(SHORT,LONG),PASCAL,DLL,NAME('_Func085@8')
         SetFileXferOptions(SHORT,SHORT,SHORT,SHORT,SHORT,SHORT),DLL,PASCAL,NAME('_Func069@24')
         SetFlowControl(SHORT,SHORT,SHORT,SHORT),DLL,PASCAL,NAME('_Func071@16')
         SetPort(SHORT port,LONG hWnd),SHORT,DLL,PASCAL,NAME('_Func026@8')
         SetPortDebug(SHORT,LONG,SHORT,SHORT,*CSTRING),SHORT,DLL,RAW,PASCAL,NAME('_Func113@20')
         SetPortEx(SHORT,LONG,SHORT,SHORT,SHORT,SHORT,SHORT),SHORT,DLL,PASCAL,NAME('_Func073@28')
         SetPortExDebug(SHORT,LONG,SHORT,SHORT,SHORT,SHORT,SHORT,SHORT,SHORT,*CSTRING),SHORT,DLL,RAW,PASCAL,NAME('_Func075@40')
         SetPortHaveID(SHORT,UNSIGNED,UNSIGNED),SHORT,DLL,PASCAL,NAME('_Func076@12')
         SetReceiveNotify(SHORT port,LONG hWnd,SHORT bytes),SHORT,DLL,PASCAL,NAME('_Func077@12')
         SetTermOptions(SHORT,SHORT,*CSTRING,*CSTRING),RAW,DLL,PASCAL,NAME('_Func078@16')
         SetTermType(SHORT port, SHORT type, *CSTRING keyfile),SHORT,RAW,DLL,PASCAL,NAME('_Func088@12')
         SetZmodemXferOptions(SHORT,SHORT,SHORT,SHORT),DLL,PASCAL,NAME('_Func070@16')
         StartAProcess(*CSTRING ImageName, *CSTRING CommandLine, *CSTRING WinClass, *CSTRING WinTitle),USHORT,DLL,RAW,PASCAL,NAME('_Func081@16')
         StartAProcessWait(*CSTRING ImageName, *CSTRING CommandLine, SHORT hide),SHORT,DLL,RAW,PASCAL,PROC,NAME('_Func082@12')
         StrHex(*CSTRING),SHORT,RAW,DLL,PASCAL,NAME('_Func083@4')
         StrWord(*CSTRING,*CSTRING),SHORT,RAW,DLL,PASCAL,NAME('_Func084@8')
         SuspendReceiveNotify(SHORT,SHORT),DLL,PASCAL,NAME('_Func116@8')
         TxFree(SHORT),SHORT,DLL,PASCAL,NAME('_Func086@4')
         TxUsed(SHORT),SHORT,DLL,PASCAL,NAME('_Func087@4')
         UpLoad(SHORT,LONG,SHORT),SHORT,DLL,PROC,PASCAL,NAME('_Func079@12')
         UploadEx(SHORT,LONG,SHORT,*CSTRING,*CSTRING,SHORT),SHORT,RAW,DLL,PROC,PASCAL,NAME('_Func090@24')
      END

      MODULE('Windows API')
         ClaGetDeskTopWindow(),LONG,DLL,PASCAL,NAME('GETDESKTOPWINDOW')
         ClaShellExecute(LONG,*CSTRING,*CSTRING,*CSTRING,*CSTRING,LONG),LONG,PROC,DLL,RAW,PASCAL,NAME('ShellExecuteA')
         ClaCallNextHookEx(LONG,LONG,LONG,LONG),LONG,DLL,PASCAL,NAME('CALLNEXTHOOKEX')
         ClaCallWindowProc(LONG,LONG,LONG,LONG,LONG),LONG,DLL,PASCAL,NAME('CALLWINDOWPROCA')
         ClaCopyFile(*CSTRING,*CSTRING,SHORT),SHORT,PROC,DLL,RAW,PASCAL,NAME('CopyFileA')
         ClaCreateEvent(<*GROUP>,SIGNED,SIGNED,<*CSTRING>),UNSIGNED,RAW,PROC,DLL,PASCAL,NAME('CreateEventA')
         ClaCreateThread(<*GROUP>,ULONG,ULONG,LONG,ULONG,*ULONG),UNSIGNED,RAW,DLL,PASCAL
         ClaDefWindowProc(LONG,LONG,LONG,LONG),LONG,DLL,PASCAL,NAME('DEFWINDOWPROCA')
         ClaDeleteFile(*CSTRING),SHORT,PROC,DLL,RAW,PASCAL,NAME('DeleteFileA')
         ClaEnableWindow(LONG,SHORT),DLL,PASCAL,NAME('ENABLEWINDOW')
         ClaFindCloseChangeNotification(UNSIGNED),SIGNED,PROC,DLL,PASCAL
         ClaFindFirstChangeNotification(*CSTRING,SIGNED,ULONG),UNSIGNED,RAW,DLL,PASCAL,NAME('FindFirstChangeNotificationA')
         ClaFindNextChangeNotification(UNSIGNED),SIGNED,PROC,DLL,PASCAL
         ClaFlashWindow(LONG,SHORT),DLL,PASCAL,NAME('FLASHWINDOW')
         ClaGetCurrentProcess(),LONG,DLL,PASCAL,NAME('GETCURRENTPROCESS')
         ClaGetCurrentThread(),LONG,DLL,PASCAL,NAME('GETCURRENTTHREAD')
         ClaGetCurrentThreadId(),LONG,DLL,PASCAL,NAME('GETCURRENTTHREADID')
         ClaMoveFile(*CSTRING,*CSTRING),SHORT,PROC,DLL,RAW,PASCAL,NAME('MoveFileA')
         ClaPostMessage(LONG,LONG,LONG,LONG),SHORT,DLL,PROC,PASCAL,NAME('POSTMESSAGEA')
         ClaResumeThread(UNSIGNED),ULONG,PROC,DLL,PASCAL
         ClaSetEvent(UNSIGNED),SIGNED,PROC,DLL,PASCAL
         ClaSetThreadPriority(UNSIGNED,SIGNED),SIGNED,PROC,DLL,PASCAL
         ClaSetWindowLong(LONG,LONG,LONG),LONG,DLL,PASCAL,NAME('SETWINDOWLONGA')
         ClaSetWindowsHookEx(LONG,LONG,LONG,LONG),LONG,DLL,PASCAL,NAME('SETWINDOWSHOOKEXA')
         ClaUnHookWindowsHookEx(LONG),DLL,PASCAL,NAME('UNHOOKWINDOWSHOOKEX')
         ClaWaitForSingleObject(UNSIGNED,ULONG),ULONG,PROC,DLL,PASCAL
      END
***
   !
   ! 16 Bit Programs, include these Prototypes
   !
OMIT('***', _WIDTH32_)
      MODULE('CLACom API')
         CapPutc(SHORT,BYTE),DLL,PASCAL,NAME('FUNC003')
         CapPuts(SHORT,*CSTRING),RAW,DLL,PASCAL,NAME('FUNC004')
         CenterNonMDIWindow(USHORT ParentWin,USHORT MyWin),DLL,PASCAL,NAME('FUNC001')
         CheckIfSmallFonts(),SHORT,DLL,PASCAL,NAME('FUNC006')
         CheckIfTermActive(SHORT),SHORT,DLL,PASCAL,NAME('FUNC007')
         CLAFindWindow(*CSTRING WinClass,*CSTRING WinTitle),SHORT,RAW,DLL,PROC,PASCAL,NAME('FUNC008')
         CLATermClearScreen(SHORT port),DLL,PASCAL,NAME('FUNC096')
         CLATermClientProc(SHORT,USHORT,USHORT,USHORT,LONG),LONG,DLL,PROC,PASCAL,NAME('FUNC092')
         CLATermDoorWay(SHORT port,SHORT flag),DLL,PASCAL,NAME('FUNC095')
         CLATermEcho(SHORT port,SHORT flag),DLL,PASCAL,NAME('FUNC094')
         CLATermGainFocus(SHORT port),DLL,PASCAL,NAME('FUNC099')
         CLATermGetMessage(LONG msgaddr,*GROUP clamsg),DLL,RAW,PASCAL,NAME('FUNC093')
         CLATermHookMsg(LONG hkprc),LONG,PASCAL,DLL,NAME('FUNC101')
         CLATermPrepareTransfer(SHORT port,SHORT how),DLL,PASCAL,NAME('FUNC097')
         CLATermSetBackColor(SHORT port,SHORT how),PASCAL,DLL,NAME('FUNC098')
         CLATermSetNotify(SHORT port,SHORT how),SHORT,PROC,DLL,PASCAL,NAME('FUNC119')
         CLATermWndProc(SHORT,USHORT,USHORT,USHORT,LONG),LONG,DLL,PASCAL,NAME('FUNC091')
         ClearVariable(*CSTRING,SHORT,SHORT),RAW,DLL,PASCAL,NAME('FUNC110')
         ClrBuf(SHORT),DLL,PASCAL,NAME('FUNC017')
         ClrRecvBuf(SHORT),DLL,PASCAL,NAME('FUNC023')
         ClrTransBuf(SHORT),DLL,PASCAL,NAME('FUNC011')
         ComDelay(USHORT,SHORT),SHORT,DLL,PASCAL,PROC,NAME('FUNC012')
         ComGetb(SHORT,*CSTRING),SHORT,RAW,DLL,PASCAL,NAME('FUNC013')
         ComGetbFilter(SHORT,*CSTRING),SHORT,RAW,DLL,PASCAL,NAME('FUNC014')
         ComGetBlock(SHORT,*CSTRING,SHORT),SHORT,RAW,DLL,PASCAL,NAME('FUNC015')
         ComGetBlockCRC(SHORT,*CSTRING,SHORT),SHORT,RAW,DLL,PASCAL,NAME('FUNC016')
         ComGetc(SHORT),SHORT,DLL,PASCAL,NAME('FUNC009')
         ComGetd(SHORT,USHORT,SHORT),SHORT,DLL,PASCAL,NAME('FUNC018')
         ComGets(SHORT,*CSTRING,BYTE),SHORT,RAW,DLL,PASCAL,NAME('FUNC111')
         ComPutb(SHORT,*CSTRING,SHORT),SHORT,PROC,RAW,DLL,PASCAL,NAME('FUNC010')
         ComPutbCRC(SHORT,*CSTRING,SHORT),SHORT,PROC,RAW,DLL,PASCAL,NAME('FUNC050')
         ComPutc(SHORT,BYTE),SHORT,PROC,DLL,PASCAL,NAME('FUNC025')
         ComPuts(SHORT,*CSTRING),SHORT,PROC,RAW,DLL,PASCAL,NAME('FUNC072')
         ComPutsCtrl(SHORT,*CSTRING),SHORT,PROC,RAW,DLL,PASCAL,NAME('FUNC112')
         CreateClaTerm(SHORT,USHORT,SHORT,SHORT),SHORT,DLL,PASCAL,NAME('FUNC028')
         CreateClaTermEX(SHORT,USHORT,SHORT,SHORT,LONG,SHORT,SHORT,SHORT),SHORT,DLL,PASCAL,NAME('FUNC029')
         CreateCLATermNoWin(SHORT,USHORT,SHORT,SHORT,USHORT,USHORT),SHORT,DLL,PASCAL,NAME('FUNC089')
         DebugFileOpen(SHORT port),DLL,PASCAL,NAME('FUNC030')
         DelPathFiles(*CSTRING path),RAW,DLL,PASCAL,NAME('FUNC031')
         DisplayErrors(SHORT,USHORT),DLL,PASCAL,NAME('FUNC032')
         DisplayPortError(SHORT),DLL,PASCAL,NAME('FUNC034')
         DisplayTermError(SHORT),DLL,PASCAL,NAME('FUNC035')
         DownLoad(SHORT,USHORT,SHORT),SHORT,DLL,PROC,PASCAL,NAME('FUNC047')
         DownLoadEx(SHORT,USHORT,SHORT,*CSTRING,*CSTRING),SHORT,RAW,DLL,PROC,PASCAL,NAME('FUNC066')
         Dtr(SHORT,SHORT),DLL,PASCAL,NAME('FUNC038')
         GetCommParams(SHORT,*GROUP),SHORT,RAW,DLL,PROC,PASCAL,NAME('FUNC039')
         GetConnectSpeed(*CSTRING),LONG,RAW,DLL,PASCAL,NAME('FUNC040')
         GetCRC16(*CSTRING,SHORT),USHORT,RAW,DLL,PASCAL,NAME('FUNC041')
         GetCRC32(*CSTRING,SHORT),LONG,RAW,DLL,PASCAL,NAME('FUNC042')
         GetDirectory1(USHORT parentWin,*CSTRING title,*CSTRING dir),SHORT,RAW,DLL,PASCAL,NAME('FUNC043')
         GetOpenSaveFile1(USHORT,*CSTRING,*CSTRING,*CSTRING,*CSTRING,SHORT,SHORT),SHORT,RAW,DLL,PASCAL,NAME('FUNC046')
         GetParentWindow(USHORT),USHORT,DLL,PASCAL,NAME('FUNC044')
         GetProtoNum(*CSTRING),SHORT,RAW,DLL,PASCAL,NAME('FUNC045')
         GetTermEnter(SHORT,*CSTRING,*CSTRING),RAW,DLL,PASCAL,NAME('FUNC036')
         GetWindowsPort(SHORT),SIGNED,DLL,PASCAL,NAME('FUNC048')
         GetZmodem(SHORT,USHORT),SHORT,DLL,PROC,PASCAL,NAME('FUNC114')
         GetZmodemEx(SHORT,USHORT,*CSTRING),SHORT,RAW,DLL,PROC,PASCAL,NAME('FUNC024')
         InitPort(SHORT,LONG,SHORT,SHORT,SHORT),SHORT,DLL,PROC,PASCAL,NAME('FUNC115')
         Iscd(SHORT),SHORT,DLL,PASCAL,NAME('FUNC052')
         IsRing(SHORT),SHORT,DLL,PASCAL,NAME('FUNC053')
         MakeDir(*CSTRING),SHORT,RAW,DLL,PROC,PASCAL,NAME('FUNC054')
         ModemHangUp(SHORT),DLL,PASCAL,NAME('FUNC055')
         ModemPuts(SHORT,*CSTRING),SHORT,PROC,RAW,DLL,PASCAL,NAME('FUNC056')
         ModemStat(SHORT),BYTE,DLL,PASCAL,NAME('FUNC057')
         RecvCount(SHORT),SHORT,DLL,PASCAL,NAME('FUNC058')
         ResetPort(SHORT,USHORT),SHORT,DLL,PROC,PASCAL,NAME('FUNC059')
         ResetPortHaveID(SHORT,USHORT),DLL,PASCAL,NAME('FUNC060')
         Rts(SHORT,SHORT),DLL,PASCAL,NAME('FUNC061')
         Rxempty(SHORT),SHORT,DLL,PASCAL,NAME('FUNC062')
         SendBreak(SHORT),DLL,PASCAL,NAME('FUNC063')
         SendFileWild(SHORT,USHORT,*CSTRING,*CSTRING,SHORT),SHORT,RAW,DLL,PROC,PASCAL,NAME('FUNC064')
         SendZmodem(SHORT,USHORT),SHORT,DLL,PROC,PASCAL,NAME('FUNC065')
         SendZmodemEx(SHORT,USHORT,*CSTRING,*CSTRING,SHORT),SHORT,RAW,DLL,PROC,PASCAL,NAME('FUNC037')
         SetCaptureBuf(SHORT,SHORT),SHORT,DLL,PROC,PASCAL,NAME('FUNC067')
         SetCaptureFile(SHORT,*CSTRING),RAW,DLL,PASCAL,NAME('FUNC068')
         SetCommTimeOut(SHORT,SHORT),DLL,PASCAL,NAME('FUNC118')
         SetFileXferCallBack(SHORT,LONG),PASCAL,DLL,NAME('FUNC085')
         SetFileXferOptions(SHORT,SHORT,SHORT,SHORT,SHORT,SHORT),DLL,PASCAL,NAME('FUNC069')
         SetFlowControl(SHORT,SHORT,SHORT,SHORT),DLL,PASCAL,NAME('FUNC071')
         SetPort(SHORT,USHORT),SHORT,DLL,PASCAL,NAME('FUNC026')
         SetPortDebug(SHORT,USHORT,SHORT,SHORT,*CSTRING),SHORT,DLL,RAW,PASCAL,NAME('FUNC113')
         SetPortEx(SHORT,USHORT,SHORT,SHORT,SHORT,SHORT,SHORT),SHORT,DLL,PASCAL,NAME('FUNC073')
         SetPortExDebug(SHORT,USHORT,SHORT,SHORT,SHORT,SHORT,SHORT,SHORT,SHORT,*CSTRING),SHORT,DLL,RAW,PASCAL,NAME('FUNC075')
         SetPortHaveID(SHORT,UNSIGNED,UNSIGNED),SHORT,DLL,PASCAL,NAME('FUNC076')
         SetReceiveNotify(SHORT,USHORT,SHORT),SHORT,DLL,PASCAL,NAME('FUNC077')
         SetTermOptions(SHORT,SHORT,*CSTRING,*CSTRING),RAW,DLL,PASCAL,NAME('FUNC078')
         SetTermType(SHORT,SHORT,*CSTRING),SHORT,RAW,DLL,PASCAL,NAME('FUNC088')
         SetZmodemXferOptions(SHORT,SHORT,SHORT,SHORT),DLL,PASCAL,NAME('FUNC070')
         StartAProcessWait(*CSTRING ImageName, *CSTRING CommandLine, SHORT hide),SHORT,DLL,RAW,PASCAL,PROC,NAME('FUNC082')
         StrHex(*CSTRING),SHORT,RAW,DLL,PASCAL,NAME('FUNC083')
         StrWord(*CSTRING,*CSTRING),SHORT,RAW,DLL,PASCAL,NAME('FUNC084')
         SuspendReceiveNotify(SHORT,SHORT),DLL,PASCAL,NAME('FUNC116')
         TxFree(SHORT),SHORT,DLL,PASCAL,NAME('FUNC086')
         TxUsed(SHORT),SHORT,DLL,PASCAL,NAME('FUNC087')
         UpLoad(SHORT,USHORT,SHORT),SHORT,DLL,PROC,PASCAL,NAME('FUNC079')
         UploadEx(SHORT,USHORT,SHORT,*CSTRING,*CSTRING,SHORT),SHORT,RAW,DLL,PROC,PASCAL,NAME('FUNC090')
      END

      MODULE('Windows API')
         ClaGetDeskTopWindow(),USHORT,DLL,PASCAL,NAME('GETDESKTOPWINDOW')
         ClaShellExecute(USHORT,*CSTRING,*CSTRING,*CSTRING,*CSTRING,SHORT),USHORT,PROC,DLL,RAW,PASCAL,NAME('SHELLEXECUTE')
         ClaCallNextHookEx(LONG,SHORT,USHORT,LONG),LONG,DLL,PASCAL,NAME('CALLNEXTHOOKEX')
         ClaCallWindowProc(LONG,USHORT,USHORT,USHORT,LONG),LONG,DLL,PASCAL,NAME('CALLWINDOWPROC')
         ClaDefWindowProc(USHORT,USHORT,USHORT,LONG),LONG,DLL,PASCAL,NAME('DEFWINDOWPROC')
         ClaDeleteFile(*CSTRING),SHORT,PROC,DLL,RAW,NAME('_remove')
         ClaEnableWindow(USHORT,SHORT),DLL,PASCAL,NAME('ENABLEWINDOW')
         ClaFlashWindow(USHORT,SHORT),DLL,PASCAL,NAME('FLASHWINDOW')
         ClaGetCurrentTask(),USHORT,DLL,PASCAL,NAME('GETCURRENTTASK')
         ClaGetModuleHandle(LONG),USHORT,DLL,PASCAL,NAME('GETMODULEHANDLE')
         ClaMakeProcInstance(LONG,USHORT),LONG,DLL,PASCAL,NAME('MAKEPROCINSTANCE')
         ClaPostMessage(USHORT,USHORT,USHORT,LONG),SHORT,DLL,PROC,PASCAL,NAME('POSTMESSAGE')
         ClaSetWindowLong(USHORT,SHORT,LONG),LONG,DLL,PASCAL,NAME('SETWINDOWLONG')
         ClaSetWindowsHookEx(SHORT,LONG,USHORT,LONG),LONG,DLL,PASCAL,NAME('SETWINDOWSHOOKEX')
         ClaUnHookWindowsHookEx(LONG),DLL,PASCAL,NAME('UNHOOKWINDOWSHOOKEX')
      END

***
